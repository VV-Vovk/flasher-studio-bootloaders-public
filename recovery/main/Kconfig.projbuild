## recovery/main/Kconfig.projbuild
```kconfig
menu "Flasher Recovery"
config FS_WIFI
    bool "Wi-Fi transport"
    default y
config FS_BLE
    bool "BLE transport"
    default n
endmenu
```

## recovery/sdkconfig.defaults
```kconfig
CONFIG_PARTITION_TABLE_CUSTOM=y
CONFIG_PARTITION_TABLE_CUSTOM_FILENAME="partitions.csv"
CONFIG_PARTITION_TABLE_OFFSET=0x8000
CONFIG_BOOTLOADER_FACTORY_RESET=y
CONFIG_BOOTLOADER_FACTORY_RESET_PIN_LOW=y
CONFIG_BOOTLOADER_OTA_DATA_ERASE=y
CONFIG_BOOTLOADER_DATA_FACTORY_RESET=""
CONFIG_COMPILER_OPTIMIZATION_SIZE=y
CONFIG_LOG_DEFAULT_LEVEL_WARN=y
CONFIG_MBEDTLS_SHA256_C=y
```
